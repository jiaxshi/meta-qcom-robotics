## conf/layer.conf
```bitbake
# We have a conf and classes directory, add to BBPATH
BBFILES += "${LAYERDIR}/recipes/*/*.bb \
            ${LAYERDIR}/recipes/*/*/*.bb \
            ${LAYERDIR}/recipes-*/*/*.bb \
            ${LAYERDIR}/recipes-*/*/*.bbappend \
            ${LAYERDIR}/recipes-*/*.bb \
            ${LAYERDIR}/recipes-*/*/*/*.bbappend \
"

BBPATH .= ":${LAYERDIR}"
BBFILE_COLLECTIONS += "qcom-robotics"
BBFILE_PATTERN_qcom-robotics = "^${LAYERDIR}/"
BBFILE_PRIORITY_qcom-robotics = "12"
LAYERSERIES_COMPAT_qcom-robotics = "whinlatter"

# PREFERRED_VERSION_librealsense2 ?= "2.54.2"
# PREFERRED_VERSION_opencv ?= "4.5.5"
# PREFERRED_VERSION_fuse = "2.9.9"
# PREFERRED_VERSION_octomap = "1.9.8%"
# PREFERRED_VERSION_libcamera = "0.4.0"

# SAMPLE_SOURCE = "${TOPDIR}/sample_source"

# ros_base_prefix = "/usr"

# BB_DANGLINGAPPENDS_WARNONLY = "true"

# ROBOT_PBT_ARTIFACTORY = "https://softwarecenter.qualcomm.com/download/software/chip/qualcomm_linux-spf-1-0/qualcomm-linux-spf-1-0_test_device_pb_qirpsdk"
# ROBOT_PBT_BUILD_ID    = "r1.0_00100.0"
# ROBOT_PBT_BIN_PATH    = "le-qcrobotics-1-0-r1/apps_proc/prebuilt_HY22/${BPN}"
# PBT_ARCH ?= "${SOC_ARCH}"
```
